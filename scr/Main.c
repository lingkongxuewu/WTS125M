/*--------------------------------文*件*信*息-----------------------------
* 项目名: 
* 文件名：  Main.c
* 版　本：  v1.0
* 描  述：  100T双轴 整合后的版本
* 创建人：   
* 日  期：   
--------------------------------------------------------------------------
*当前版本:	v1.0
*修 改 人:
*日　  期:
----------------------------------修改履历--------------------------------
1、
2、
3、
4、
------------------------------------------------------------------------*/
#define   __MAIN_C__
#include  "_Include.h"
//***********************************************************************/
// *功    能： 开关量初始化
// *入    口：
// *出    口：
// *备    注：
// *函数性质：
//***********************************************************************/
void Main_Temp (void)
{
    LED_X_OFF();
    LED_Y_OFF();
    LED_S_OFF();
}
//***********************************************************************/
void main (void)
{
//	int16u xdata adc;
    SFRPAGE = ACTIVE_PAGE;    		// Set for PCA0MD
    PCA0MD &= ~0x40;          		// WDTE = 0 (clear watchdog timer enable)
    Init_All();
    EA = 1;
    Flash_CalDataInit();	 		//SYS and USER
    MenuId=MOD_MOD0;
    Main_Temp();
	delay_ms(250);
    while(1)
    {
        SnProc();                    //角度计算
        Timer2_TaskInMain();		 //主动发送模式
        Send_TimeProc();			 //COMM的处理函数
		if(SysPowOnTag==1)
		{
			if(CompCalTag==0)	Comp_AngCntProc();
			else				Comp_CalSampProc();
		}
    }
}
//***********************************************************************/
